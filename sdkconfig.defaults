## sdkconfig.defaults
```kconfig
CONFIG_BT_ENABLED=y
CONFIG_BT_BLUEDROID_ENABLED=y
CONFIG_BT_CLASSIC_ENABLED=y
CONFIG_BT_SSP_ENABLED=y
CONFIG_BT_A2DP_ENABLE=y
CONFIG_BT_A2DP_SINK=y
CONFIG_BT_SPP_ENABLED=n
CONFIG_BT_BLE_ENABLED=n
CONFIG_BTDM_CTRL_MODE_BR_EDR_ONLY=y

CONFIG_USB_HOST_ENABLED=y
CONFIG_TINYUSB_HOST_ENABLED=y

# I2S std driver
CONFIG_I2S_STD_SUPPORT=y

# LVGL minimal defaults (if applicable)
CONFIG_LVGL_USE_PERF_MONITOR=n
CONFIG_LV_CONF_SKIP=y
CONFIG_LV_CONF_PATH="lv_conf.h"
```
